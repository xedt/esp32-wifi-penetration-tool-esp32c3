## components/wifi_controller/Kconfig
```kconfig
# put here your custom config value
menu "Wi-Fi Controller"
    config SCAN_MAX_AP
        int "Maximun AP scanned"
        default 20
        help
        Maximum number of scanned nearby AP
    menu "Management AP"
        config MGMT_AP_SSID
            string "Management AP SSID"
            default "ManagementAP"
            help
            SSID of management AP

        config MGMT_AP_PASSWORD
            string "Management AP Password"
            default "mgmtadmin"
            help
            Password for management AP WPA2 (minimum 8 characters)

        config MGMT_AP_CHANNEL
            int "Management AP channel"
            range 1 13
            default 3
            help
            Channel on which management AP should run
            
        config MGMT_AP_MAX_CONNECTIONS
            int "Maximum number of connected clients"
            range 0 10
            default 1
            help
            Password for management AP

        config MGMT_AP_AUTH_OFF
            bool "No protected open management AP"
            default y
            help
                If set to true, authmode WPA2-PSK will NOT be used.
    endmenu
endmenu
```

## sdkconfig.defaults
```kconfig
CONFIG_ESP32_WIFI_NVS_ENABLED=n
CONFIG_IDF_TARGET="esp32c3"
CONFIG_ESP_PHY_CALIBRATION_MODE=0
```
